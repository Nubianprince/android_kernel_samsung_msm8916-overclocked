## arch/arm/configs/msm8916_sec_o7lte_swaopen_defconfig
```kconfig
CONFIG_SEC_O7_PROJECT=y
CONFIG_MACH_O7_SWA_OPEN=y
CONFIG_SM5703_MUIC=y
CONFIG_USBID_STANDARD_VER_01=y
CONFIG_MUIC_SUPPORT_RUSTPROOF=y
CONFIG_MUIC_SUPPORT_CHARGING_CABLE=y
CONFIG_MUIC_SUPPORT_DESKDOCK=y
CONFIG_SEC_GPIO_SETTINGS=y
CONFIG_CHECK_SIMSLOT_COUNT=y
CONFIG_CHECK_SIMSLOT_COUNT_DT=y
CONFIG_TOUCHSCREEN_ZT7538_TS=y
CONFIG_TOUCHSCREEN_IST30XXC=y
CONFIG_MFD_SM5703=y
CONFIG_REGULATOR_SM5703=y
CONFIG_S5K3L2XX=y
CONFIG_S5K5E3YX=y
CONFIG_CAMERA_SYSFS_V2=y
CONFIG_PANEL_S6D7AA0X62_BV050HDM_HD_5_5=y
CONFIG_PANEL_ILI9881C_SKI550002_HD=y
CONFIG_FLASHLIGHT=y
CONFIG_SM_FLASH_LED=y
CONFIG_FLED_SM5703=y
CONFIG_FLED_SM5703_EXT_GPIO=y
CONFIG_SM5703_VIBRATOR=y
CONFIG_BATTERY_SAMSUNG=y
CONFIG_BATTERY_SAMSUNG_DATA_FILE="o7_battery_data.h"
CONFIG_BATTERY_SWELLING=y
CONFIG_FUELGAUGE_SM5703=y
CONFIG_PREVENT_SOC_JUMP=y
CONFIG_CHARGER_SM5703=y
CONFIG_CHARGER_SM5703_SOFT_START_CHARGING=y
CONFIG_CHARGER_SM5703_DUALPATH=y
CONFIG_SAMSUNG_LPM_MODE=y
CONFIG_SIOP_CHARGING_LIMIT_CURRENT=700
CONFIG_SENSORS_CORE=y
CONFIG_SENSORS_K2HH=y
CONFIG_SENSORS_CM36672P=y
CONFIG_SENSORS_STK3013=y
CONFIG_RESTART_REASON_SEC_PARAM=y
```

## arch/arm/configs/msm8916_sec_rossa_spr_defconfig
```kconfig
CONFIG_SEC_ROSSA_PROJECT=y
CONFIG_MACH_ROSSA_SPR=y
CONFIG_SM5502_MUIC=y
CONFIG_USBID_STANDARD_VER_01=y
CONFIG_MUIC_SUPPORT_RUSTPROOF=y
CONFIG_SEC_GPIO_SETTINGS=y
CONFIG_TOUCHSCREEN_IST30XX_CORE3=y
CONFIG_MFD_RT5033=y
# CONFIG_MFD_RT5033_RESET_WA is not set
CONFIG_REGULATOR_RT5033=y
CONFIG_MSM_OTP=y
CONFIG_SR200PC20=y
CONFIG_S5K5E3YX=y
CONFIG_SR552=y
CONFIG_PANEL_HX8369B_BV045WVM_WVGA=y
CONFIG_LEDS_KTD2026=y
CONFIG_FLASHLIGHT=y
CONFIG_RT_FLASH_LED=y
CONFIG_FLED_RT5033=y
CONFIG_FLED_RT5033_EXT_GPIO=y
CONFIG_MSM_VIBRATOR=y
CONFIG_BATTERY_SAMSUNG=y
CONFIG_BATTERY_SAMSUNG_DATA_FILE="rossa_battery_data.h"
CONFIG_FUELGAUGE_RT5033=y
CONFIG_CHARGER_RT5033=y
CONFIG_SAMSUNG_LPM_MODE=y
CONFIG_SENSORS_CORE=y
CONFIG_SENSORS_K2HH=y
CONFIG_SENSORS_K2HH_VDD=y
CONFIG_SENSORS_GP2A002=y
```

## arch/arm/configs/msm8916_sec_serranove3g_eur_defconfig
```kconfig
CONFIG_SEC_SERRANOVE_PROJECT=y
CONFIG_MACH_SERRANOVE3G_EUR_OPEN=y
CONFIG_SEC_FPGA_ICE40XX=y
CONFIG_SM5502_MUIC=y
CONFIG_SM5504_MUIC=y
CONFIG_USBID_STANDARD_VER_01=y
CONFIG_MUIC_SUPPORT_RUSTPROOF=y
CONFIG_MUIC_SUPPORT_CHARGING_CABLE=y
CONFIG_SEC_GPIO_SETTINGS=y
CONFIG_CHECK_SIMSLOT_COUNT=y
CONFIG_CHECK_SIMSLOT_COUNT_DT=y
CONFIG_SENSORS_HALL=y
CONFIG_KEYBOARD_TC360_TKEY=y
CONFIG_TOUCHSCREEN_ZINITIX_BT541=y
CONFIG_TOUCHSCREEN_MXT336S=y
CONFIG_MFD_RT5033=y
CONFIG_REGULATOR_RT5033=y
CONFIG_S5K6A3YX=y
CONFIG_S5K4H5YB=y
CONFIG_PANEL_S6E88A0_AMS427AP24_QHD=y
CONFIG_AUDIO_QUAT_I2S_ENABLE=y
CONFIG_USB_XHCI_HCD=y
CONFIG_USB_OTG_WAKELOCK=y
CONFIG_NO_DETECT_PIN=y
CONFIG_QPNP_VIBRATOR=y
CONFIG_IIO=y
CONFIG_IIO_BUFFER_CB=y
CONFIG_ST_LSM6DS3_IIO=y
CONFIG_SENSORS_YAS_MAGNETOMETER=y
CONFIG_SENSORS_GP2A030_IIO=y
CONFIG_BATTERY_SAMSUNG=y
CONFIG_BATTERY_SAMSUNG_DATA_FILE="serranovelte_battery_data.h"
CONFIG_FUELGAUGE_RT5033=y
CONFIG_CHARGER_RT5033=y
CONFIG_SAMSUNG_LPM_MODE=y
CONFIG_SIOP_CHARGING_LIMIT_CURRENT=700
CONFIG_SENSORS_CORE=y
CONFIG_RESTART_REASON_SEC_PARAM=y
```

## arch/arm/configs/selinux_defconfig
```kconfig
CONFIG_AUDIT=y
CONFIG_NF_CONNTRACK_SECMARK=y
CONFIG_NETFILTER_XT_TARGET_CONNSECMARK=y
CONFIG_IP_NF_SECURITY=y
CONFIG_EXT4_FS_SECURITY=y
CONFIG_PROC_AVC=y
CONFIG_F2FS_FS_SECURITY=y
CONFIG_SECURITY=y
CONFIG_SECURITY_NETWORK=y
CONFIG_LSM_MMAP_MIN_ADDR=4096
CONFIG_SECURITY_SELINUX=y
```
