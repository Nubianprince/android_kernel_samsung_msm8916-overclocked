## arch/arm/configs/msm8916_sec_a3_eur_defconfig
```kconfig
CONFIG_SEC_A3_EUR_PROJECT=y
CONFIG_MACH_A3_EUR_OPEN=y
CONFIG_NFC=y
CONFIG_SEC_NFC_I2C=y
CONFIG_SEC_NFC=y
CONFIG_SEC_NFC_USE_8916_BBCLK2=y
CONFIG_SM5502_MUIC=y
CONFIG_USBID_STANDARD_VER_01=y
CONFIG_MUIC_SUPPORT_RUSTPROOF_INBATT=y
CONFIG_MUIC_SUPPORT_CHARGING_CABLE=y
CONFIG_SEC_GPIO_SETTINGS=y
CONFIG_CHECK_SIMSLOT_COUNT=y
CONFIG_CHECK_SIMSLOT_COUNT_DT=y
CONFIG_SENSORS_HALL=y
CONFIG_KEYBOARD_ABOV_TOUCH_A3=y
CONFIG_TOUCHSCREEN_ZINITIX_BT541=y
CONFIG_MFD_RT5033=y
CONFIG_MFD_RT5033_RESET_GPIO=y
CONFIG_REGULATOR_RT5033=y
CONFIG_IMX219=y
CONFIG_S5K5E3YX=y
CONFIG_PANEL_S6E88A0_AMS452EF01_QHD=y
CONFIG_AUDIO_SPEAKER_OUT_NXP_AMP_ENABLE=y
CONFIG_AUDIO_QUAT_I2S_ENABLE=y
CONFIG_SEC_HYBRID_TRAY=y
CONFIG_FLASHLIGHT=y
CONFIG_RT_FLASH_LED=y
CONFIG_FLED_RT5033=y
CONFIG_FLED_RT5033_EXT_GPIO=y
CONFIG_SS_VIBRATOR=y
CONFIG_BATTERY_SAMSUNG=y
CONFIG_BATTERY_SAMSUNG_DATA_FILE="a3_battery_data.h"
CONFIG_BATTERY_SWELLING=y
CONFIG_FUELGAUGE_RT5033=y
CONFIG_CHARGER_RT5033=y
CONFIG_SAMSUNG_LPM_MODE=y
CONFIG_SENSORS_CORE=y
CONFIG_SENSORS_CM36652=y
CONFIG_SENSORS_CM36652_LEDA_EN_GPIO=y
CONFIG_SENSORS_BMA2X2=y
CONFIG_SENSORS_BMA2X2_ENABLE_INT1=y
CONFIG_SENSORS_BMM050=y
CONFIG_SENSORS_ACCELEROMETER_2G=y
CONFIG_RESTART_REASON_SEC_PARAM=y
```

## arch/arm/configs/msm8916_sec_a5_chnopen_defconfig
```kconfig
CONFIG_SEC_A5_PROJECT=y
CONFIG_MACH_A5_CHN_OPEN=y
CONFIG_SM5502_MUIC=y
CONFIG_USBID_STANDARD_VER_01=y
CONFIG_MUIC_SUPPORT_RUSTPROOF_INBATT=y
CONFIG_MUIC_SUPPORT_CHARGING_CABLE=y
CONFIG_SEC_GPIO_SETTINGS=y
CONFIG_SENSORS_HALL=y
CONFIG_KEYBOARD_ABOV_TOUCH_A3=y
CONFIG_TOUCHSCREEN_ZINITIX_BT541=y
CONFIG_MFD_RT5033=y
CONFIG_MFD_RT5033_RESET_GPIO=y
CONFIG_REGULATOR_RT5033=y
CONFIG_S5K5E3YX=y
CONFIG_AUDIO_SPEAKER_OUT_NXP_AMP_ENABLE=y
CONFIG_AUDIO_QUAT_I2S_ENABLE=y
CONFIG_SEC_HYBRID_TRAY=y
CONFIG_FLASHLIGHT=y
CONFIG_RT_FLASH_LED=y
CONFIG_FLED_RT5033=y
CONFIG_FLED_RT5033_EXT_GPIO=y
CONFIG_SS_VIBRATOR=y
CONFIG_BATTERY_SAMSUNG=y
CONFIG_BATTERY_SAMSUNG_DATA_FILE="a5_battery_data.h"
CONFIG_BATTERY_SWELLING=y
CONFIG_FUELGAUGE_RT5033=y
CONFIG_CHARGER_RT5033=y
CONFIG_SAMSUNG_LPM_MODE=y
CONFIG_SENSORS_CORE=y
CONFIG_SENSORS_BMA2X2=y
CONFIG_SENSORS_BMA2X2_ENABLE_INT1=y
CONFIG_SENSORS_BMM050=y
CONFIG_SENSORS_BMC150_VDD=y
CONFIG_SENSORS_TMD3782S=y
CONFIG_SENSORS_ACCELEROMETER_2G=y
```

## arch/arm/configs/msm8916_sec_fortuna_chnzt_defconfig
```kconfig
CONFIG_SEC_FORTUNA_PROJECT=y
CONFIG_MACH_FORTUNA_CHN_ZT=y
CONFIG_NFC_PN547=y
CONFIG_NFC_PN547_8916_USE_BBCLK2=y
CONFIG_SM5502_MUIC=y
CONFIG_SM5504_MUIC=y
CONFIG_USBID_STANDARD_VER_01=y
CONFIG_MUIC_SUPPORT_RUSTPROOF=y
CONFIG_SEC_GPIO_SETTINGS=y
CONFIG_CHECK_SIMSLOT_COUNT=y
CONFIG_CHECK_SIMSLOT_COUNT_DT=y
CONFIG_TOUCHSCREEN_ZINITIX_BT541=y
CONFIG_MFD_RT5033=y
CONFIG_MFD_RT5033_SLDO_VBUSDET=y
CONFIG_REGULATOR_RT5033=y
CONFIG_APC_CPR_QUOT_BOOST=y
CONFIG_IMX219=y
CONFIG_SR200PC20=y
CONFIG_SR030PC50=y
CONFIG_SR544=y
CONFIG_S5K6A3YX=y
CONFIG_S5K5E3YX=y
CONFIG_S5K4ECGX=y
CONFIG_SR130PC20=y
CONFIG_PANEL_HX8389C_GH9607501A_QHD=y
CONFIG_PANEL_S6D78A0_GH9607501A_QHD=y
CONFIG_FLASHLIGHT=y
CONFIG_RT_FLASH_LED=y
CONFIG_FLED_RT5033=y
CONFIG_FLED_RT5033_EXT_GPIO=y
CONFIG_MSM_VIBRATOR=y
CONFIG_BATTERY_SAMSUNG=y
CONFIG_BATTERY_SAMSUNG_DATA_FILE="fortuna_battery_data.h"
CONFIG_FUELGAUGE_RT5033=y
CONFIG_CHARGER_RT5033=y
CONFIG_SAMSUNG_LPM_MODE=y
CONFIG_SENSORS_CORE=y
CONFIG_SENSORS_K2HH=y
CONFIG_SENSORS_K2HH_VDD=y
CONFIG_SENSORS_GP2A002=y
CONFIG_SENSORS_GP2A_VDD=y
CONFIG_RESTART_REASON_SEC_PARAM=y
```

## arch/arm/configs/msm8916_sec_fortuna_defconfig
```kconfig
CONFIG_SEC_FORTUNA_PROJECT=y
CONFIG_MACH_FORTUNA=y
CONFIG_NFC=y
CONFIG_NFC_PN547=y
CONFIG_NFC_PN547_8916_USE_BBCLK2=y
CONFIG_SEC_NFC=y
CONFIG_SEC_NFC_USE_8916_BBCLK2=y
CONFIG_SM5502_MUIC=y
CONFIG_SM5504_MUIC=y
CONFIG_USBID_STANDARD_VER_01=y
CONFIG_MUIC_SUPPORT_RUSTPROOF=y
CONFIG_SEC_GPIO_SETTINGS=y
CONFIG_CHECK_SIMSLOT_COUNT=y
CONFIG_CHECK_SIMSLOT_COUNT_DT=y
CONFIG_TOUCHSCREEN_ZINITIX_BT541=y
CONFIG_MFD_RT5033=y
CONFIG_MFD_RT5033_SLDO_VBUSDET=y
CONFIG_REGULATOR_RT5033=y
CONFIG_APC_CPR_QUOT_BOOST=y
CONFIG_IMX219=y
CONFIG_S5K4H5YB=y
CONFIG_S5K5E3YX=y
CONFIG_S5K4ECGX=y
CONFIG_PANEL_HX8389C_GH9607501A_QHD=y
CONFIG_PANEL_S6D78A0_GH9607501A_QHD=y
CONFIG_SEC_HYBRID_TRAY=y
CONFIG_FLASHLIGHT=y
CONFIG_RT_FLASH_LED=y
CONFIG_FLED_RT5033=y
CONFIG_FLED_RT5033_EXT_GPIO=y
CONFIG_MSM_VIBRATOR=y
CONFIG_SS_VIBRATOR=y
CONFIG_BATTERY_SAMSUNG=y
CONFIG_BATTERY_SAMSUNG_DATA_FILE="fortuna_battery_data.h"
CONFIG_FUELGAUGE_RT5033=y
CONFIG_CHARGER_RT5033=y
CONFIG_SAMSUNG_LPM_MODE=y
CONFIG_SENSORS_CORE=y
CONFIG_SENSORS_K2HH=y
CONFIG_SENSORS_K2HH_VDD=y
CONFIG_SENSORS_K303C=y
CONFIG_SENSORS_GP2A002=y
CONFIG_SENSORS_GP2A_VDD=y
CONFIG_SENSORS_PROX_NEWMODE2=y
CONFIG_SENSORS_BMA2X2=y
CONFIG_SENSORS_BMA2X2_ENABLE_INT1=y
CONFIG_SENSORS_BMM050=y
CONFIG_INPUT_BMA2x2_ACC_ALERT_INT=y
CONFIG_CHARGER_NOTIFY_SENSOR=y
CONFIG_RESTART_REASON_SEC_PARAM=y
```

## arch/arm/configs/msm8916_sec_fortuna_sea_defconfig
```kconfig
CONFIG_SEC_FORTUNA_PROJECT=y
CONFIG_MACH_FORTUNA_SEA_OPEN=y
CONFIG_NFC=y
CONFIG_SEC_NFC_I2C=y
CONFIG_SEC_NFC=y
CONFIG_SEC_NFC_USE_8916_BBCLK2=y
CONFIG_SM5502_MUIC=y
CONFIG_USBID_STANDARD_VER_01=y
CONFIG_MUIC_SUPPORT_RUSTPROOF=y
CONFIG_SEC_GPIO_SETTINGS=y
CONFIG_TOUCHSCREEN_ZINITIX_BT541=y
CONFIG_MFD_RT5033=y
CONFIG_MFD_RT5033_SLDO_VBUSDET=y
CONFIG_REGULATOR_RT5033=y
CONFIG_IMX219=y
CONFIG_S5K5E3YX=y
CONFIG_PANEL_HX8389C_GH9607501A_QHD=y
CONFIG_PANEL_S6D78A0_GH9607501A_QHD=y
CONFIG_FLASHLIGHT=y
CONFIG_RT_FLASH_LED=y
CONFIG_FLED_RT5033=y
CONFIG_FLED_RT5033_EXT_GPIO=y
CONFIG_MSM_VIBRATOR=y
CONFIG_BATTERY_SAMSUNG=y
CONFIG_BATTERY_SAMSUNG_DATA_FILE="fortuna_battery_data.h"
CONFIG_FUELGAUGE_RT5033=y
CONFIG_CHARGER_RT5033=y
CONFIG_SAMSUNG_LPM_MODE=y
CONFIG_SENSORS_CORE=y
CONFIG_SENSORS_K303C=y
CONFIG_SENSORS_GP2A002=y
CONFIG_SENSORS_GP2A_VDD=y
```

## arch/arm/configs/msm8916_sec_gt510wifi_eur_defconfig
```kconfig
CONFIG_SEC_GT510_PROJECT=y
CONFIG_MACH_GT510WIFI_EUR_OPEN=y
CONFIG_EXTEND_SERIAL_NUM_16=y
CONFIG_MUIC_SUPPORT_RUSTPROOF=y
CONFIG_MUIC_SUPPORT_CHARGING_CABLE=y
CONFIG_SENSORS_HALL=y
CONFIG_TOUCHSCREEN_ATMEL_MXT1664T=y
CONFIG_MFD_MAX77849=y
CONFIG_APC_CPR_QUOT_BOOST=y
CONFIG_SR200PC20=y
CONFIG_SR544=y
CONFIG_SENSOR_8_BPP=y
CONFIG_PANEL_S6D7AA0_LTL101AT01_WXGA=y
CONFIG_PANEL_S6D7AA0_BOE_LTL101AT01_WXGA=y
CONFIG_AUDIO_SPEAKER_OUT_MAXIM_AMP_ENABLE=y
CONFIG_AUDIO_QUAT_I2S_ENABLE=y
CONFIG_EXTCON=y
CONFIG_EXTCON_MAX77849=y
CONFIG_ADC_ONESHOT=y
CONFIG_MUIC_SUPPORT_DESK_DOCK=y
CONFIG_MUIC_SUPPORT_LANHUB=y
CONFIG_BATTERY_SAMSUNG=y
CONFIG_BATTERY_SAMSUNG_DATA_FILE="gt510_battery_data.h"
CONFIG_BATTERY_SWELLING=y
CONFIG_BATTERY_SWELLING_SELF_DISCHARGING=y
CONFIG_FUELGAUGE_MAX77849=y
CONFIG_FUELGAUGE_MAX77849_COULOMB_COUNTING=y
CONFIG_PREVENT_SOC_JUMP=y
CONFIG_CHARGER_MAX77849=y
CONFIG_SAMSUNG_LPM_MODE=y
CONFIG_SENSORS_CORE=y
CONFIG_SENSORS_K2HH=y
CONFIG_SENSORS_K2HH_VDD=y
CONFIG_SENSORS_CM3323=y
CONFIG_SENSORS_TCS3490=y
CONFIG_SENSORS_SX9500_WIFI=y
CONFIG_SENSORS_SX9500_WIFI_INIT_TOUCH_THRESHOLD=2000
CONFIG_SENSORS_SX9500_WIFI_NORMAL_TOUCH_THRESHOLD=10
CONFIG_SENSORS_SX9500_WIFI_DEFENCE_CODE_FOR_TA_NOISE=y
CONFIG_SENSORS_SX9500_WIFI_REGULATOR_ONOFF=y
CONFIG_RESTART_REASON_SEC_PARAM=y
```

## arch/arm/configs/msm8916_sec_gtelwifi_usa_defconfig
```kconfig
CONFIG_SEC_GTEL_PROJECT=y
CONFIG_MACH_GTELWIFI_USA_OPEN=y
CONFIG_EXTEND_SERIAL_NUM_16=y
CONFIG_SM5703_MUIC=y
CONFIG_USBID_STANDARD_VER_01=y
CONFIG_MUIC_SUPPORT_RUSTPROOF=y
CONFIG_MUIC_SM5703_SUPPORT_LANHUB_TA=y
CONFIG_SEC_GPIO_SETTINGS=y
CONFIG_INPUT_BOOSTER=y
CONFIG_TOUCHSCREEN_ZT7554_TS=y
CONFIG_MFD_SM5703=y
CONFIG_REGULATOR_SM5703=y
CONFIG_APC_CPR_QUOT_BOOST=y
CONFIG_SR200PC20=y
CONFIG_S5K4ECGX=y
CONFIG_CAMERA_SYSFS_V2=y
CONFIG_SENSOR_8_BPP=y
CONFIG_PANEL_NT51017_B4P096WX5VP09_WXGA=y
CONFIG_FLASHLIGHT=y
CONFIG_RT_FLASH_LED=y
CONFIG_BATTERY_SAMSUNG=y
CONFIG_BATTERY_SAMSUNG_DATA_FILE="gtel_battery_data.h"
CONFIG_CHARGING_VZWCONCEPT=y
CONFIG_BATTERY_SWELLING=y
CONFIG_BATTERY_SWELLING_SELF_DISCHARGING=y
CONFIG_FUELGAUGE_SM5703=y
CONFIG_PREVENT_SOC_JUMP=y
CONFIG_CHARGER_SM5703=y
CONFIG_CHARGER_SM5703_SOFT_START_CHARGING=y
CONFIG_SAMSUNG_LPM_MODE=y
CONFIG_SIOP_CHARGING_LIMIT_CURRENT=1900
CONFIG_SENSORS_CORE=y
CONFIG_SENSORS_K2HH=y
CONFIG_SENSORS_K2HH_VDD=y
CONFIG_SENSORS_SX9500=y
CONFIG_SENSORS_SX9500_INIT_TOUCH_THRESHOLD=2000
CONFIG_SENSORS_SX9500_NORMAL_TOUCH_THRESHOLD=7
CONFIG_SENSORS_SX9500_DEFENCE_CODE_FOR_TA_NOISE=y
CONFIG_SENSORS_SX9500_REGULATOR_ONOFF=y
CONFIG_SENSORS_SX9500_WIFI=y
CONFIG_SENSORS_SX9500_WIFI_INIT_TOUCH_THRESHOLD=2000
CONFIG_SENSORS_SX9500_WIFI_NORMAL_TOUCH_THRESHOLD=4
CONFIG_SENSORS_SX9500_WIFI_DEFENCE_CODE_FOR_TA_NOISE=y
CONFIG_SENSORS_SX9500_WIFI_REGULATOR_ONOFF=y
CONFIG_RESTART_REASON_SEC_PARAM=y
```

## arch/arm/configs/msm8916_sec_gtes_spr_defconfig
```kconfig
CONFIG_SEC_GTES_PROJECT=y
CONFIG_MACH_GTES_USA_SPR=y
CONFIG_BARCODE_PAINTER=y
CONFIG_SM5703_MUIC=y
CONFIG_USBID_STANDARD_VER_01=y
CONFIG_MUIC_SUPPORT_RUSTPROOF=y
CONFIG_MUIC_SUPPORT_CHARGING_CABLE=y
CONFIG_MUIC_SM5703_SUPPORT_LANHUB_TA=y
CONFIG_SEC_GPIO_SETTINGS=y
CONFIG_TOUCHSCREEN_ZT7548_TS=y
CONFIG_MFD_SM5703=y
CONFIG_REGULATOR_SM5703=y
CONFIG_APC_CPR_QUOT_BOOST=y
CONFIG_S5K4ECGX=y
CONFIG_DB8221A=y
CONFIG_CAM_DUAL_POWER_SEQ=y
CONFIG_CAMERA_SYSFS_V2=y
CONFIG_SENSOR_8_BPP=y
CONFIG_PANEL_S6D7AA0X11_TV080WXM_WXGA=y
CONFIG_FLASHLIGHT=y
CONFIG_RT_FLASH_LED=y
CONFIG_SM5703_VIBRATOR=y
CONFIG_BATTERY_SAMSUNG=y
CONFIG_BATTERY_SAMSUNG_DATA_FILE="gtes_battery_data.h"
CONFIG_BATTERY_SWELLING=y
CONFIG_FUELGAUGE_SM5703=y
CONFIG_PREVENT_SOC_JUMP=y
CONFIG_CHARGER_SM5703=y
CONFIG_SAMSUNG_LPM_MODE=y
CONFIG_SIOP_CHARGING_LIMIT_CURRENT=1700
CONFIG_SW_SELF_DISCHARGING=y
CONFIG_SENSORS_CORE=y
CONFIG_SENSORS_K2HH=y
CONFIG_SENSORS_K2HH_VDD=y
CONFIG_SENSORS_SX9500_NORMAL_TOUCH_THRESHOLD=11
CONFIG_SENSORS_SX9500_REGULATOR_ONOFF=y
CONFIG_SENSORS_SX9500_ALWAYS=y
CONFIG_RESTART_REASON_SEC_PARAM=y
```

## arch/arm/configs/msm8916_sec_j3lte_kor_defconfig
```kconfig
CONFIG_SEC_J3_PROJECT=y
CONFIG_MACH_J3LTE_KOR_OPEN=y
CONFIG_SM5703_MUIC=y
CONFIG_USBID_STANDARD_VER_01=y
CONFIG_MUIC_SUPPORT_RUSTPROOF=y
CONFIG_MUIC_SUPPORT_CHARGING_CABLE=y
CONFIG_MUIC_SUPPORT_DESKDOCK=y
CONFIG_SEC_GPIO_SETTINGS=y
CONFIG_CHECK_SIMSLOT_COUNT=y
CONFIG_CHECK_SIMSLOT_COUNT_DT=y
CONFIG_SENSORS_HALL=y
CONFIG_KEYBOARD_TC360_TKEY_J3=y
CONFIG_TOUCHSCREEN_IST30XXC=y
CONFIG_RTC_AUTO_PWRON=y
CONFIG_RTC_AUTO_PWRON_PARAM=y
CONFIG_MFD_SM5703=y
CONFIG_REGULATOR_SM5703=y
CONFIG_APC_CPR_QUOT_BOOST=y
CONFIG_S5K4H5YC=y
CONFIG_S5K5E3YX=y
CONFIG_CAMERA_SYSFS_V2=y
CONFIG_PANEL_S6E8AA5X01_AMS497HY01_HD=y
CONFIG_NFC=y
CONFIG_NFC_PN547=y
CONFIG_NFC_PN547_8916_USE_BBCLK2=y
CONFIG_NFC_PN547_8916_CLK_CTL=y
CONFIG_NFC_PN547_PVDD_EN_CONTROL=y
CONFIG_SW_100K_TO_GND=y
CONFIG_SEC_HYBRID_TRAY=y
CONFIG_FLASHLIGHT=y
CONFIG_SM_FLASH_LED=y
CONFIG_FLED_SM5703=y
CONFIG_FLED_SM5703_EXT_GPIO=y
CONFIG_SM5703_VIBRATOR=y
CONFIG_BATTERY_SAMSUNG=y
CONFIG_BATTERY_SAMSUNG_DATA_FILE="j3_battery_data.h"
CONFIG_BATTERY_SWELLING=y
CONFIG_FUELGAUGE_SM5703=y
CONFIG_PREVENT_SOC_JUMP=y
CONFIG_CHARGER_SM5703=y
CONFIG_CHARGER_SM5703_SOFT_START_CHARGING=y
CONFIG_CHARGER_SM5703_DUALPATH=y
CONFIG_SAMSUNG_LPM_MODE=y
CONFIG_SIOP_CHARGING_LIMIT_CURRENT=1000
CONFIG_SENSORS_CORE=y
CONFIG_SENSORS_K2HH=y
CONFIG_SENSORS_GP2A002=y
CONFIG_SENSORS_GP2A_MODE_B15=y
CONFIG_SENSORS_GP2A_VDD=y
CONFIG_TDMB=y
CONFIG_TDMB_VENDOR_FCI=y
CONFIG_TDMB_FC8080=y
CONFIG_TDMB_SPI=y
CONFIG_TDMB_QUALCOMM=y
CONFIG_TDMB_XTAL_FREQ=y
CONFIG_TDMB_VREG_SUPPORT=y
CONFIG_RESTART_REASON_SEC_PARAM=y
```

## arch/arm/configs/msm8916_sec_j53g_eur_defconfig
```kconfig
CONFIG_SEC_J5_PROJECT=y
CONFIG_MACH_J53G_EUR_OPEN=y
CONFIG_SM5703_MUIC=y
CONFIG_USBID_STANDARD_VER_01=y
CONFIG_MUIC_SUPPORT_RUSTPROOF=y
CONFIG_MUIC_SUPPORT_CHARGING_CABLE=y
CONFIG_MUIC_SUPPORT_DESKDOCK=y
CONFIG_SEC_GPIO_SETTINGS=y
CONFIG_CHECK_SIMSLOT_COUNT=y
CONFIG_CHECK_SIMSLOT_COUNT_DT=y
CONFIG_SENSORS_HALL=y
CONFIG_KEYBOARD_TC360_TKEY_J5=y
CONFIG_TOUCHSCREEN_IST30XXC=y
CONFIG_MFD_SM5703=y
CONFIG_REGULATOR_SM5703=y
CONFIG_APC_CPR_QUOT_BOOST=y
CONFIG_S5K3L2XX=y
CONFIG_S5K5E3YX=y
CONFIG_CAMERA_SYSFS_V2=y
CONFIG_FRONT_FLASH=y
CONFIG_PANEL_S6D7AA0X62_BV050HDM_HD_5_5=y
CONFIG_PANEL_S6E8AA5X01_AMS497HY01_720P=y
CONFIG_SW_100K_TO_GND=y
CONFIG_FLASHLIGHT=y
CONFIG_SM_FLASH_LED=y
CONFIG_FLED_SM5703=y
CONFIG_FLED_SM5703_EXT_GPIO=y
CONFIG_FLED_LM3632=y
CONFIG_FLED_KTD2692=y
CONFIG_SM5703_VIBRATOR=y
CONFIG_BATTERY_SAMSUNG=y
CONFIG_BATTERY_SAMSUNG_DATA_FILE="j5_battery_data.h"
CONFIG_BATTERY_SWELLING=y
CONFIG_FUELGAUGE_SM5703=y
CONFIG_PREVENT_SOC_JUMP=y
CONFIG_CHARGER_SM5703=y
CONFIG_SAMSUNG_LPM_MODE=y
CONFIG_SIOP_CHARGING_LIMIT_CURRENT=1000
CONFIG_SENSORS_CORE=y
CONFIG_SENSORS_K2HH=y
CONFIG_SENSORS_GP2A002=y
CONFIG_SENSORS_GP2A_MODE_B15=y
CONFIG_SENSORS_GP2A_VDD=y
CONFIG_RESTART_REASON_SEC_PARAM=y
```

## arch/arm/configs/msm8916_sec_j5lte_chncmcc_defconfig
```kconfig
CONFIG_SEC_J5_PROJECT=y
CONFIG_MACH_J5LTE_CHN_CMCC=y
CONFIG_NFC_PN547=y
CONFIG_NFC_PN547_8916_USE_BBCLK2=y
CONFIG_NFC_PN547_8916_CLK_CTL=y
CONFIG_NFC_PN547_USE_EXTERNAL_LDO_VIO=y
CONFIG_SM5703_MUIC=y
CONFIG_USBID_STANDARD_VER_01=y
CONFIG_MUIC_SUPPORT_RUSTPROOF=y
CONFIG_MUIC_SUPPORT_CHARGING_CABLE=y
CONFIG_MUIC_SUPPORT_DESKDOCK=y
CONFIG_SEC_GPIO_SETTINGS=y
CONFIG_CHECK_SIMSLOT_COUNT=y
CONFIG_CHECK_SIMSLOT_COUNT_DT=y
CONFIG_TOUCHSCREEN_IST30XXC=y
CONFIG_MFD_SM5703=y
CONFIG_REGULATOR_SM5703=y
CONFIG_APC_CPR_QUOT_BOOST=y
CONFIG_S5K3L2XX=y
CONFIG_S5K5E3YX=y
CONFIG_CAMERA_SYSFS_V2=y
CONFIG_FRONT_FLASH=y
CONFIG_PANEL_S6D7AA0X62_BV050HDM_HD_5_5=y
CONFIG_PANEL_ILI9881C_SKI499017_HD=y
CONFIG_SEC_HYBRID_TRAY=y
CONFIG_FLASHLIGHT=y
CONFIG_SM_FLASH_LED=y
CONFIG_FLED_SM5703=y
CONFIG_FLED_SM5703_EXT_GPIO=y
CONFIG_FLED_LM3632=y
CONFIG_FLED_KTD2692=y
CONFIG_SM5703_VIBRATOR=y
CONFIG_BATTERY_SAMSUNG=y
CONFIG_BATTERY_SAMSUNG_DATA_FILE="j5_battery_data.h"
CONFIG_BATTERY_SWELLING=y
CONFIG_FUELGAUGE_SM5703=y
CONFIG_PREVENT_SOC_JUMP=y
CONFIG_CHARGER_SM5703=y
CONFIG_SAMSUNG_LPM_MODE=y
CONFIG_SIOP_CHARGING_LIMIT_CURRENT=1000
CONFIG_SENSORS_CORE=y
CONFIG_SENSORS_K2HH=y
CONFIG_SENSORS_GP2A002=y
CONFIG_SENSORS_GP2A_MODE_B15=y
CONFIG_SENSORS_GP2A_VDD=y
CONFIG_RESTART_REASON_SEC_PARAM=y
```

## arch/arm/configs/msm8916_sec_j5xlte_eur_defconfig
```kconfig
CONFIG_SEC_J5X_PROJECT=y
CONFIG_MACH_J5XLTE_EUR_OPEN=y
CONFIG_NFC=y
CONFIG_NFC_PN547=y
CONFIG_NFC_PN547_8916_USE_BBCLK2=y
CONFIG_NFC_PN547_8916_CLK_CTL=y
CONFIG_NFC_PN547_PVDD_EN_CONTROL=y
CONFIG_SM5703_MUIC=y
CONFIG_USBID_STANDARD_VER_01=y
CONFIG_MUIC_SUPPORT_RUSTPROOF=y
CONFIG_MUIC_SUPPORT_CHARGING_CABLE=y
CONFIG_MUIC_SUPPORT_DESKDOCK=y
CONFIG_SEC_GPIO_SETTINGS=y
CONFIG_CHECK_SIMSLOT_COUNT=y
CONFIG_CHECK_SIMSLOT_COUNT_DT=y
CONFIG_SENSORS_HALL=y
CONFIG_TOUCHKEY_GRIP=y
CONFIG_KEYBOARD_TC305_TKEY=y
CONFIG_KEYBOARD_TC360_TKEY_J5X=y
CONFIG_TOUCHSCREEN_IST30XXC_CMCS=y
CONFIG_MFD_SM5703=y
CONFIG_REGULATOR_SM5703=y
CONFIG_MSM_FRONT_EEPROM=y
CONFIG_MSM_OTP=y
CONFIG_S5K3L2XX=y
CONFIG_S5K5E3YX=y
CONFIG_CAMERA_SYSFS_V2=y
CONFIG_FRONT_FLASH=y
CONFIG_SR552=y
CONFIG_PANEL_S6E8AA5X01_AMS520KT01_HD=y
CONFIG_FLASHLIGHT=y
CONFIG_SM_FLASH_LED=y
CONFIG_FLED_SM5703=y
CONFIG_FLED_SM5703_EXT_GPIO=y
CONFIG_FLED_KTD2692=y
CONFIG_SM5703_VIBRATOR=y
CONFIG_BATTERY_SAMSUNG=y
CONFIG_BATTERY_SAMSUNG_DATA_FILE="j5x_battery_data.h"
CONFIG_BATTERY_SWELLING=y
CONFIG_FUELGAUGE_SM5703=y
CONFIG_PREVENT_SOC_JUMP=y
CONFIG_CHARGER_SM5703=y
CONFIG_CHARGER_SM5703_DUALPATH=y
CONFIG_SAMSUNG_LPM_MODE=y
CONFIG_SIOP_CHARGING_LIMIT_CURRENT=700
CONFIG_SW_SELF_DISCHARGING=y
CONFIG_SENSORS_CORE=y
CONFIG_SENSORS_K2HH=y
CONFIG_SENSORS_CM36672P=y
CONFIG_SENSORS_CM36672P_SMART_PERS=y
CONFIG_SENSORS_SX9310=y
CONFIG_RESTART_REASON_SEC_PARAM=y
```
